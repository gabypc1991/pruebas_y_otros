#include <Arduino.h>
#include <ESP8266WiFi.h>
#include <WiFiClient.h>
#include <ESP8266WebServer.h>
#include <ESP8266mDNS.h>
#include <EEPROM.h>
#include "Adafruit_Si7021.h"

#define EEPROM_SIZE 4096

#ifndef APSSID
#define APSSID "PROJECTOR_LASER"
#define APPSK  "123456789"
#endif

unsigned long currentTime = millis();
unsigned long previousTime = 0; 
const long timeoutTime = 2000;

const char *ssid = APSSID;
const char *password = APPSK;

String pagina = "index";
String header;

const int delta_t_table[41][101]{
                                  {365,331,389,436,452,459,462,463,464,464,464,464,463,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21,13},
                                  {345,355,430,481,498,505,507,508,507,506,505,504,502,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21,12},
                                  {372,397,476,529,546,552,553,553,551,549,547,544,542,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20,11},
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                                  {2559,2517,2529,2533,2478,2410,2360,2308,2258,2208,2142,2101,2060,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2,-15},
                                  };


const int sensorPin = 10;
const int measureInterval = 2500;
volatile int pulseConter;

int viento_min = 3;
int viento_med = 15;
int viento_max = 21;

bool enableHeater = false;
float factorK = 1;
float factorKh = 1;
float factorKt = 1;
float h;
float t;
float dt;
float flow_Lmin;

LiquidCrystal_I2C lcd(0x27, 16, 2);
WiFiServer server(80);
//DHT dht(DHTPIN, DHTTYPE);
Adafruit_Si7021 sensor = Adafruit_Si7021();

void ICACHE_RAM_ATTR isr() {  
  
  static unsigned long last_interrupt_time = 0;
  unsigned long interrupt_time = millis();
  // If interrupts come faster than 200ms, assume it's a bounce and ignore
  if (interrupt_time - last_interrupt_time > 2) 
  {
    pulseConter++;
  }
  last_interrupt_time = interrupt_time;  
}

float GetFrequency()
{
   pulseConter = 0;
   interrupts();
   delay(measureInterval);
   read_dht();
   webExc();
//   granizo();
   noInterrupts();   
   return (float)pulseConter * 1000 / measureInterval;
}

void granizo(){
  if(pulseConter > 0){
    lcd.setCursor(0, 0);lcd.print("  CAYO GRANIZO! ");
    lcd.setCursor(0, 1);lcd.print("      AYER      ");
    delay(1500);
    lcd.setCursor(0, 0);lcd.print("      PUTO      ");
    lcd.setCursor(0, 1);lcd.print("                ");
    delay(500);
    lcd.setCursor(0, 0);lcd.print("                ");
    lcd.setCursor(0, 1);lcd.print("                ");
    }
  }

void setup()
{
  pinMode(LED_A_R, OUTPUT);
  pinMode(LED_A_G, OUTPUT);
  pinMode(LED_B_R, OUTPUT);
  pinMode(LED_B_G, OUTPUT);
  digitalWrite(LED_A_R, LOW);
  digitalWrite(LED_A_G, LOW);
  digitalWrite(LED_B_R, LOW);
  digitalWrite(LED_B_G, LOW);  
  analogWriteRange(255);
  EEPROM.begin(EEPROM_SIZE);  
//  eeprom_fst_write();
  EEPROM.get(0, factorK);
  EEPROM.get(4, factorKh);
  EEPROM.get(8, factorKt);
  EEPROM.get(12, viento_min);
  EEPROM.get(16, viento_med);
  EEPROM.get(20, viento_max);
  Serial.begin(115200);
  sensor.begin();
  lcd.begin(16, 2);
  lcd.init();
  lcd.backlight();
  lcd.clear();
  lcd.setCursor(0, 0);lcd.print("    Estacion    ");
  lcd.setCursor(0, 1);lcd.print(" Meteorologica  ");
  delay(2000);
  lcd.setCursor(0, 0);lcd.print("Mod.    em001   ");
  lcd.setCursor(0, 1);lcd.print("SW ver. 0.xx    ");
  delay(2000);
  encendido_led(1,1);
  delay(500);
  encendido_led(1,2);
  delay(500);
  encendido_led(1,3);
  delay(500);
  encendido_led(2,1);
  delay(500);
  encendido_led(2,2);
  delay(500);
  encendido_led(2,3);
  delay(500);
  encendido_led(1,0);
  encendido_led(2,0);
  Serial.print("Configurando punto de acceso...");
  WiFi.softAP(ssid, password);
  IPAddress myIP = WiFi.softAPIP();
  Serial.print("Direccion de IP AP: ");
  Serial.println(myIP);  
  server.begin();
  Serial.println("HTTP server en linea");
  lcd.clear();  
  lcd.setCursor(0, 0);lcd.print("V:");
  lcd.setCursor(9, 0);lcd.print("Dt:");
  lcd.setCursor(0, 1);lcd.print("Te:");
  lcd.setCursor(9, 1);lcd.print("Hr:");   
  pinMode(sensorPin, INPUT_PULLUP);
  attachInterrupt(sensorPin, isr, FALLING);
}

void eeprom_fst_write(){
    EEPROM.put(0, 1.2f);
    EEPROM.commit();
    EEPROM.put(4, 1.0f);
    EEPROM.commit();
    EEPROM.put(8, 1.0f);
    EEPROM.commit();
    EEPROM.put(12, 3);
    EEPROM.commit();
    EEPROM.put(16, 15);
    EEPROM.commit();
    EEPROM.put(20, 21);
    EEPROM.commit();
  }

void encendido_led(int led, int color){
  if(led == 1){
    if(color == 1){
      analogWrite(LED_A_R, 120);
      analogWrite(LED_A_G, 0);
     }else if(color == 2){
      analogWrite(LED_A_R, 120);
      analogWrite(LED_A_G, 150);
     }else if(color == 3){
      analogWrite(LED_A_R, 0);
      analogWrite(LED_A_G, 150);
     }else if(color == 0){
      analogWrite(LED_A_R, 0);
      analogWrite(LED_A_G, 0);
      }     
   }
  if(led == 2){
    if(color == 1){
      analogWrite(LED_B_R, 120);
      analogWrite(LED_B_G, 0);
     }else if(color == 2){
      analogWrite(LED_B_R, 120);
      analogWrite(LED_B_G, 150);
      }else if(color == 3){
      analogWrite(LED_B_R, 0);
      analogWrite(LED_B_G, 150);
      }else if(color == 0){
      analogWrite(LED_B_R, 0);
      analogWrite(LED_B_G, 0);
      }             
   }  
  }

void leer_dt(int i, int j){  
  if(t >= 0 && t <= 40){
      dt = (float)delta_t_table[i][j] / 100;
    }else{
     dt = 0;
   }
}  

void led_dt(){  
    if(dt <= 1){encendido_led(1,1);}
    if(dt > 1 && dt <= 2){encendido_led(1,2);}
    if(dt > 2 && dt <= 8){encendido_led(1,3);}
    if(dt > 8 && dt <= 11){encendido_led(1,2);}
    if(dt > 11){encendido_led(1,1);}   
  }

void led_viento(){
  static unsigned long t_millis = millis();
  static unsigned long dif_millis;
  static int muestras;
  static int v_prom;
  static int v_prom_res;
  static bool muestra_def;

  muestras++;
  v_prom += flow_Lmin;
  if(muestras > 15){
    v_prom_res = v_prom / muestras;
    v_prom = 0;
    muestras = 0;
    muestra_def = true;
   }
  /*
  if((dif_millis - t_millis) > 1000){
    muestras++;
    v_prom += flowLmin;
    if(muestras > 60){
      v_prom_res = v_prom / muestras;
      v_prom = 0;
      muestras = 0;
     }
     dif_millis = millis();
    }  
   */
  if(muestra_def == true){
    if(v_prom_res <= viento_min){encendido_led(2,2);}
    if(v_prom_res > viento_min && v_prom_res <= viento_med){encendido_led(2,3);}
    if(v_prom_res > viento_med && v_prom_res <= viento_max){encendido_led(2,2);}
    if(v_prom_res > viento_max){encendido_led(2,1);}
   }else{
    encendido_led(2,0);
    }
  }

void read_dht(){
  h = sensor.readHumidity();
  h = h / factorKt;
  t = sensor.readTemperature();
  t = t / factorKh;
}

void loop()
{     
   float frequency = GetFrequency();
   flow_Lmin = frequency / factorK;     
   leer_dt(int(t), int(h));
   led_dt();
   led_viento();
   lcd.setCursor(2, 0);lcd.print(flow_Lmin,0);lcd.print("km ");
   lcd.setCursor(12, 0);lcd.print(dt,1);
   lcd.setCursor(3, 1);lcd.print(t,0);lcd.print("c");
   lcd.setCursor(12, 1);lcd.print(h,0);lcd.print("%");
   Serial.println(flow_Lmin,0); 
   
}


   
